## esp32_firmware/main/Kconfig.projbuild
```kconfig
menu "LED Pillar Firmware"

config FW_WIFI_SSID
    string "WiFi SSID"
    default ""

config FW_WIFI_PASSWORD
    string "WiFi password"
    default ""

config FW_HOSTNAME
    string "Device hostname"
    default "led-pillar"

config FW_MDNS_ENABLED
    bool "Enable mDNS advertisement"
    default y

config FW_V12_REMAP_LOGICAL
    bool "Remap v1/v2 frame payload from logical order"
    default n
    help
        Enable this only when incoming v1/v2 frame payload is in logical XY order.
        Keep disabled when sender already emits physical serpentine order.

config FW_LED_GAMMA_X100
    int "LED output gamma x100"
    range 10 500
    default 280
    help
        Gamma correction as gamma*100 for LED output. Examples:
        100 = 1.0 (no correction), 220 = 2.2, 280 = 2.8.

config FW_OTA_ENABLED
    bool "Enable wireless HTTPS OTA support"
    default y

config FW_OTA_DEFAULT_URL
    string "Default OTA image URL"
    depends on FW_OTA_ENABLED
    default "https://example.com/led_pillar_firmware.bin"

config FW_OTA_USE_CRT_BUNDLE
    bool "Use ESP x509 certificate bundle for OTA by default"
    depends on FW_OTA_ENABLED
    default y

config FW_OTA_ALLOW_INSECURE
    bool "Allow OTA without full certificate verification"
    depends on FW_OTA_ENABLED
    default n
    help
        Intended only for development environments. This relaxes certificate
        validation when no cert bundle or server cert is provided.

config FW_OTA_HTTP_TIMEOUT_MS
    int "OTA HTTP timeout (ms)"
    depends on FW_OTA_ENABLED
    range 1000 120000
    default 10000

endmenu
```

## esp32_firmware/sdkconfig.defaults
```kconfig
CONFIG_ESPTOOLPY_FLASHSIZE_4MB=y
CONFIG_ESP_WIFI_ENABLED=y
CONFIG_ESP_DEFAULT_CPU_FREQ_MHZ_240=y
CONFIG_ESP_DEFAULT_CPU_FREQ_MHZ=240
CONFIG_ESP32_DEFAULT_CPU_FREQ_240=y
CONFIG_ESP32_DEFAULT_CPU_FREQ_MHZ=240
CONFIG_ESP_WIFI_STATIC_RX_BUFFER_NUM=10
CONFIG_ESP_WIFI_DYNAMIC_RX_BUFFER_NUM=32
CONFIG_ESP_MAIN_TASK_STACK_SIZE=8192
CONFIG_BOOTLOADER_APP_ROLLBACK_ENABLE=y
CONFIG_PARTITION_TABLE_TWO_OTA=y
CONFIG_MBEDTLS_CERTIFICATE_BUNDLE=y
CONFIG_MBEDTLS_CERTIFICATE_BUNDLE_DEFAULT_FULL=y
CONFIG_FW_OTA_ENABLED=y
CONFIG_FW_OTA_DEFAULT_URL="https://example.com/led_pillar_firmware.bin"
CONFIG_FW_OTA_USE_CRT_BUNDLE=y
CONFIG_FW_OTA_ALLOW_INSECURE=n
CONFIG_FW_OTA_HTTP_TIMEOUT_MS=10000
CONFIG_FW_WIFI_AP_SSID="led-pillar"
CONFIG_FW_WIFI_AP_PASSWORD="ledpillar"
CONFIG_FW_WIFI_AP_MAX_CONN=2
CONFIG_FW_LED_GAMMA_X100=280
```
